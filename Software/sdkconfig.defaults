## firmware/cyberwand_esp/Kconfig
```kconfig
# CyberWand KConfig 配置

menu "CyberWand Configuration"

config CYBERWAND_DEVICE_NAME
    string "Device Name"
    default "CyberWand"
    help
        Bluetooth device name advertised to other devices.

config CYBERWAND_WORK_MODE
    int "Default Work Mode"
    default 0
    range 0 1
    help
        0: Record Mode (IMU→USB)
        1: Control Mode (IMU→BLE)

config CYBERWAND_POSE_THRESHOLD_FIST
    int "Fist Pose Threshold (mg)"
    default 1500
    help
        Threshold for fist detection (Z-axis acceleration).

config CYBERWAND_POSE_THRESHOLD_WAVE
    int "Wave Pose Threshold (mg/mdps)"
    default 800
    help
        Threshold for wave detection (X-axis accel + Y-axis gyro).

config CYBERWAND_POSE_THRESHOLD_ROTATE
    int "Rotate Pose Threshold (mdps)"
    default 500
    help
        Threshold for rotation detection (Z-axis gyro).

config CYBERWAND_POSE_THRESHOLD_TILT
    int "Tilt Pose Threshold (mg)"
    default 300
    help
        Threshold for tilt detection (X-axis acceleration).

config CYBERWAND_MPU_I2C_SDA_GPIO
    int "MPU6050 I2C SDA GPIO"
    default 6
    help
        GPIO pin for I2C SDA.

config CYBERWAND_MPU_I2C_SCL_GPIO
    int "MPU6050 I2C SCL GPIO"
    default 7
    help
        GPIO pin for I2C SCL.

config CYBERWAND_BUTTON_GPIO
    int "Button GPIO Pin"
    default 4
    help
        GPIO pin for mode switch button.

config CYBERWAND_LED_GPIO
    int "LED GPIO Pin"
    default 3
    help
        GPIO pin for status LED.

config CYBERWAND_BLE_SERVICE_UUID
    int "BLE Service UUID (16-bit)"
    default 0x1000
    help
        BLE Service UUID for CyberWand.

config CYBERWAND_BLE_CHAR_UUID
    int "BLE Characteristic UUID (16-bit)"
    default 0x1001
    help
        BLE Characteristic UUID for gesture data.

config CYBERWAND_DATA_LOGGING_ENABLED
    bool "Enable USB Data Logging"
    default y
    help
        Enable IMU data logging via USB in Record Mode.

endmenu
```

## firmware/cyberwand_esp/sdkconfig.defaults
```kconfig
# CyberWand sdkconfig 默认配置

# 目标芯片
CONFIG_IDF_TARGET="esp32c6"

# 串口配置
CONFIG_ESP_CONSOLE_UART_DEFAULT=y
CONFIG_ESP_CONSOLE_UART_NUM=0

# USB 串口配置
CONFIG_USB_SERIAL_JTAG_SUPPORT=y

# I2C 配置 (MPU6050)
CONFIG_DRIVER_I2C_ENABLE=y

# 蓝牙配置
CONFIG_BT_ENABLED=y
CONFIG_BT_NIMBLE_ENABLED=y
CONFIG_BT_NIMBLE_ROLE_PERIPHERAL=y

# Log 级别
CONFIG_LOG_DEFAULT_LEVEL_DEBUG=y

# 分区表
CONFIG_PARTITION_TABLE_SINGLE_APP=y

# Flash 大小
CONFIG_ESPTOOLPY_FLASHSIZE_4MB=y

# 优化级别
CONFIG_COMPILER_OPTIMIZATION_PERF=y

# 浮点运算支持
CONFIG_NEWLIB_NANO_FORMAT=y
```
